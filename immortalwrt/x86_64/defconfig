## immortalwrt/x86_64/defconfig
```kconfig
# ==========================================
# 1. 核心平台与目标架构
# ==========================================
CONFIG_TARGET_x86=y
CONFIG_TARGET_x86_64=y
CONFIG_TARGET_x86_64_DEVICE_generic=y

# ==========================================
# 2. 分区扩容 (2GB 超大空间)
# ==========================================
CONFIG_TARGET_KERNEL_PARTSIZE=100
CONFIG_TARGET_ROOTFS_PARTSIZE=2048

# ==========================================
# 3. 基础 LuCI 与 核心组件
# ==========================================
CONFIG_PACKAGE_luci=y
CONFIG_PACKAGE_luci-base=y
CONFIG_PACKAGE_luci-mod-admin-full=y

# ==========================================
# 4. 主题外观 (以 Design 为主)
# ==========================================
CONFIG_PACKAGE_luci-theme-design=y
CONFIG_PACKAGE_luci-app-design-config=y
CONFIG_PACKAGE_luci-theme-bootstrap=y
CONFIG_PACKAGE_luci-theme-argon=y
CONFIG_PACKAGE_luci-app-argon-config=y
CONFIG_PACKAGE_luci-theme-material=y
CONFIG_PACKAGE_luci-theme-netgear=y

# ==========================================
# 5. iStore 商店纯净版
# ==========================================
CONFIG_PACKAGE_luci-app-store=y
CONFIG_PACKAGE_luci-i18n-store-zh-cn=y
CONFIG_PACKAGE_taskd=y
CONFIG_PACKAGE_luci-lib-taskd=y

# ==========================================
# 6. 系统管理与文件辅助 (含 Diskman)
# ==========================================
CONFIG_PACKAGE_luci-app-ttyd=y
CONFIG_PACKAGE_luci-app-autoreboot=y
CONFIG_PACKAGE_luci-app-diskman=y
CONFIG_PACKAGE_luci-app-accesscontrol=y
CONFIG_PACKAGE_luci-app-msd_lite=y
CONFIG_PACKAGE_luci-app-ramfree=y
CONFIG_PACKAGE_luci-app-filemanager=y
CONFIG_PACKAGE_luci-app-fileassistant=y
CONFIG_PACKAGE_luci-app-commands=y
CONFIG_PACKAGE_filebrowser=y
CONFIG_PACKAGE_luci-app-filebrowser=y

# ==========================================
# 7. 磁盘格式支持 (配合 Diskman 使用)
# ==========================================
CONFIG_PACKAGE_kmod-fs-exfat=y
CONFIG_PACKAGE_kmod-fs-ext4=y
CONFIG_PACKAGE_kmod-fs-ntfs3=y
CONFIG_PACKAGE_e2fsprogs=y

# ==========================================
# 8. 性能优化 (40G/万兆核心加速)
# ==========================================
CONFIG_PACKAGE_irqbalance=y
CONFIG_PACKAGE_kmod-tcp-bbr=y
CONFIG_PACKAGE_kmod-ipt-offload=y
CONFIG_PACKAGE_luci-app-turboacc=y
CONFIG_PACKAGE_luci-app-turboacc_INCLUDE_BBR_CCA=y
CONFIG_PACKAGE_luci-app-turboacc_INCLUDE_OFFLOADING=y

# ==========================================
# 9. 网络组件与 DNS 分流
# ==========================================
CONFIG_PACKAGE_luci-app-upnp=y
CONFIG_PACKAGE_luci-app-ipv6set=y
CONFIG_PACKAGE_luci-app-openclash=y
CONFIG_PACKAGE_luci-app-ssr-plus=y
CONFIG_PACKAGE_luci-app-mosdns=y
CONFIG_PACKAGE_luci-app-smartdns=y
CONFIG_PACKAGE_luci-app-adguardhome=y

# ==========================================
# 10. VPN、DDNS 与 内网穿透
# ==========================================
CONFIG_PACKAGE_luci-app-wireguard=y
CONFIG_PACKAGE_luci-app-zerotier=y
CONFIG_PACKAGE_luci-app-ddns=y
CONFIG_PACKAGE_luci-app-ddns-go=y
CONFIG_PACKAGE_frps=y
CONFIG_PACKAGE_frpc=y
CONFIG_PACKAGE_luci-app-frpc=y
CONFIG_PACKAGE_nps=y
CONFIG_PACKAGE_npc=y
CONFIG_PACKAGE_luci-app-nps=y

# ==========================================
# 11. Docker 容器全家桶
# ==========================================
CONFIG_PACKAGE_luci-app-dockerman=y
CONFIG_PACKAGE_docker=y
CONFIG_PACKAGE_dockerd=y
CONFIG_PACKAGE_docker-compose=y
CONFIG_PACKAGE_containerd=y
CONFIG_PACKAGE_runc=y
CONFIG_PACKAGE_kmod-veth=y
CONFIG_PACKAGE_kmod-br-netfilter=y
CONFIG_PACKAGE_kmod-nf-nat=y
CONFIG_PACKAGE_kmod-ipt-nat=y
CONFIG_PACKAGE_kmod-macvlan=y

# ==========================================
# 12. 4G/5G 移动网络模块支持
# ==========================================
CONFIG_PACKAGE_luci-app-modem=y
CONFIG_PACKAGE_luci-app-modem-data=y
CONFIG_PACKAGE_luci-app-qmodem=y
CONFIG_PACKAGE_luci-app-qmodem-sms=y
CONFIG_PACKAGE_modemmanager=y
CONFIG_PACKAGE_quectel-CM-5G=y
CONFIG_PACKAGE_quectel-cm=y

# ==========================================
# 13. 监控、统计与测速
# ==========================================
CONFIG_PACKAGE_luci-app-netdata=y
CONFIG_PACKAGE_netdata=y
CONFIG_PACKAGE_luci-app-nlbwmon=y
CONFIG_PACKAGE_nlbwmon=y
CONFIG_PACKAGE_luci-app-watchcat=y
CONFIG_PACKAGE_watchcat=y
CONFIG_PACKAGE_luci-app-netspeedtest=y
CONFIG_PACKAGE_iperf3=y
CONFIG_PACKAGE_luci-app-statistics=y
CONFIG_PACKAGE_collectd-mod-interface=y
CONFIG_PACKAGE_collectd-mod-cpu=y

# ==========================================
# 14. 系统必备调试工具
# ==========================================
CONFIG_PACKAGE_htop=y
CONFIG_PACKAGE_curl=y
CONFIG_PACKAGE_wget-ssl=y
CONFIG_PACKAGE_jq=y
CONFIG_PACKAGE_bash=y
CONFIG_PACKAGE_coreutils=y
CONFIG_PACKAGE_socat=y
CONFIG_PACKAGE_luci-app-socat=y
CONFIG_PACKAGE_ethtool=y
CONFIG_PACKAGE_pciutils=y
CONFIG_PACKAGE_usbutils=y
CONFIG_PACKAGE_lm-sensors=y
CONFIG_PACKAGE_luci-app-lm-sensors=y

# ==========================================
# 15. 终极全硬件兼容驱动包 (网卡大满贯)
# ==========================================
# --- Intel 系列 ---
CONFIG_PACKAGE_kmod-ixgbe=y
CONFIG_PACKAGE_kmod-i40e=y
CONFIG_PACKAGE_kmod-igc=y
CONFIG_PACKAGE_kmod-e1000e=y
CONFIG_PACKAGE_kmod-iwlwifi=y
# --- Mellanox 系列 (40G/25G/100G) ---
CONFIG_PACKAGE_kmod-mlx4-core=y
CONFIG_PACKAGE_kmod-mlx4-en=y
CONFIG_PACKAGE_kmod-mlx5-core=y
# --- Aquantia & Broadcom & Solarflare ---
CONFIG_PACKAGE_kmod-atlantic=y
CONFIG_PACKAGE_kmod-bnxt-en=y
CONFIG_PACKAGE_kmod-sfc=y
# --- Realtek 瑞昱系列 ---
CONFIG_PACKAGE_kmod-r8125=y
CONFIG_PACKAGE_kmod-r8169=y
CONFIG_PACKAGE_kmod-usb-net-rtl8152=y
CONFIG_PACKAGE_kmod-usb-net-rtl8152-vendor=y
# --- ESXi/PVE 虚拟化支持 ---
CONFIG_PACKAGE_kmod-vmxnet3=y
CONFIG_PACKAGE_kmod-virtio-net=y
CONFIG_PACKAGE_open-vm-tools=y
# 开启网页终端 TTYd
CONFIG_PACKAGE_luci-app-ttyd=y
CONFIG_PACKAGE_ttyd=y
# 安装 PPPoE 探测工具
CONFIG_PACKAGE_pppoe-discovery=y
# 开启 SQM 流量整形插件
CONFIG_PACKAGE_luci-app-sqm=y
CONFIG_PACKAGE_sqm-scripts=y
# 推荐加上 cake 调度器（目前公认最强）
CONFIG_PACKAGE_kmod-sched-cake=y
# ==========================================
# 1. 极致底层加密与 TLS 加速 (适配 i9 SSE2)
# ==========================================
CONFIG_LIBCURL_COOKIES=y
CONFIG_LIBCURL_CRYPTO_AUTH=y
CONFIG_LIBCURL_NGHTTP2=y
CONFIG_LIBCURL_OPENSSL=y
CONFIG_LIBCURL_UNIX_SOCKETS=y
CONFIG_MBEDTLS_HAVE_SSE2=y
CONFIG_MBEDTLS_SSL_PROTO_TLS1_3=y
CONFIG_GNUTLS_ALPN=y
CONFIG_GNUTLS_OCSP=y

# ==========================================
# 2. 核心 Cgroup 优化 (让 Docker 跑得更稳)
# ==========================================
CONFIG_KERNEL_CGROUP_DEVICE=y
CONFIG_KERNEL_CGROUP_FREEZER=y
CONFIG_KERNEL_CGROUP_NET_PRIO=y
CONFIG_KERNEL_NET_CLS_CGROUP=y
CONFIG_KERNEL_PAGE_POOL=y
CONFIG_PACKAGE_cgroupfs-mount=y

# ==========================================
# 3. 5G/4G 工业模组全家桶 (备用链路支持)
# ==========================================
CONFIG_PACKAGE_luci-proto-qmi=y
CONFIG_PACKAGE_luci-proto-mbim=y
CONFIG_PACKAGE_luci-proto-quectel=y
CONFIG_PACKAGE_kmod-usb-net-qmi-wwan=y
CONFIG_PACKAGE_kmod-usb-net-cdc-mbim=y
CONFIG_PACKAGE_quectel-CM-5G=y
CONFIG_PACKAGE_modemmanager=y

# ==========================================
# 5. 编译性能提升
# ==========================================
CONFIG_USE_LLVM_BUILD=y
CONFIG_ZSTD_OPTIMIZE_O3=y
```
